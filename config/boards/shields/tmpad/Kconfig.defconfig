## config/boards/shields/tmpad/Kconfig.defconfig
```kconfig
# Copyright (c) 2022 The ZMK Contributors
# SPDX-License-Identifier: MIT

if SHIELD_TMPAD

config ZMK_KEYBOARD_NAME
    default "Tmpad"

endif
```
